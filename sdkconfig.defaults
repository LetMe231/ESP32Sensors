## sdkconfig.defaults
```kconfig
CONFIG_BT_ENABLED=y
CONFIG_BT_GATTS_SEND_SERVICE_CHANGE_MANUAL=y
CONFIG_BT_BTU_TASK_STACK_SIZE=4512
CONFIG_PARTITION_TABLE_SINGLE_APP_LARGE=y
CONFIG_BLE_MESH=y
CONFIG_BLE_MESH_NODE=y
CONFIG_BLE_MESH_PB_GATT=y
CONFIG_BLE_MESH_TX_SEG_MSG_COUNT=10
CONFIG_BLE_MESH_RX_SEG_MSG_COUNT=5
CONFIG_BLE_MESH_RX_SDU_MAX=96
CONFIG_BLE_MESH_SENSOR_SRV=y
CONFIG_BLE_MESH_SENSOR_SERVER=y
CONFIG_BLE_MESH_SENSOR_MODEL=y
CONFIG_BLE_MESH_GENERIC_ONOFF_SRV=y
CONFIG_BLE_MESH_GENERIC_SERVER=y
CONFIG_BT_BLUEDROID_ENABLED=y
CONFIG_BT_BLE_DYNAMIC_ENV_MEMORY=y
CONFIG_BLUEDROID_PINNED_TO_CORE_0=y
CONFIG_BT_BLE_42_FEATURES_SUPPORTED=y
CONFIG_BT_BLE_LEGACY_ADV_ENABLE=y
CONFIG_BLE_MESH_DF_SRV=y
CONFIG_BLE_MESH_BRC_SRV=y

# ─── Partition table ─────────────────────────────────────────────
# Switch from the default single-app layout to our custom csv so the
# BLE baseline build (which crosses the 1 MB default) fits.

CONFIG_PARTITION_TABLE_CUSTOM=y
CONFIG_PARTITION_TABLE_CUSTOM_FILENAME="partitions.csv"
CONFIG_PARTITION_TABLE_FILENAME="partitions.csv"
CONFIG_PARTITION_TABLE_OFFSET=0x8000

# ─── Core dump to flash ──────────────────────────────────────────
# Gives you a real backtrace if the node crashes during the 12h run.
# Without this, a crash is invisible past the UART log you're watching.
CONFIG_ESP_COREDUMP_ENABLE_TO_FLASH=y
CONFIG_ESP_COREDUMP_DATA_FORMAT_ELF=y
CONFIG_ESP_COREDUMP_CHECKSUM_CRC32=y
CONFIG_ESP_COREDUMP_LOGS=y

# ─── Flash size ──────────────────────────────────────────────────
# The dev-kits ship with ≥4 MB; set explicitly so the build doesn't
# fail on the coredump partition tail.
CONFIG_ESPTOOLPY_FLASHSIZE_4MB=y
CONFIG_ESPTOOLPY_FLASHSIZE="4MB"
```
